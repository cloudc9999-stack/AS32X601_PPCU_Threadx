# AS32x601 register map
File version: 1.0
CPU: RISC-V, little endian
Registers are 32-bit, read-write, reset 0x0 unless marked. A register's access mark holds for its fields unless they carry their own. Offsets are from the block's base; lines under a group give offsets from that group; [hi:lo] are bit positions; {n}, {i} and the like mark numbered series; 'fields as' and 'values as' point back to an identical list; <NAME> marks a mode.

## Memory map
0x30000000 MPU_IBUS size 0x400 — MPU I-Port Bus Protection Unit
0x30000400 MPU_DBUS size 0x400 — MPU D-Port Bus Protection Unit
0x30000800 MPU_PBUS size 0x400 — MPU P-Port Bus Protection Unit
0x30000C00 MPU_DMA0 size 0x400 — MPU DMA0-Port Protection Unit
0x30001000 MPU_DMA1 size 0x400 — MPU DMA1-Port Protection Unit
0x30003000 CMU0 size 0x400 — Clock Monitoring Unit 0
0x30003400 CMU1 size 0x400 — Clock Monitoring Unit 1
0x30003800 CMU2 size 0x400 — Clock Monitoring Unit 2
0x30003C00 CMU3 size 0x400 — Clock Monitoring Unit 3
0x30004000 FCU size 0x400 — Fault Collection Unit
0x30004000 DMA0 size 0x400 — General Purpose DMA Controller 0
0x30004400 DMA1 size 0x400 — General Purpose DMA Controller 1
0x30006000 SMU size 0x400 — System Management Unit
0x30010000 CLINT size 0x10000 — Core-Local Interruptor
0x30020000 PLIC size 0x10000 — Core-Local Interruptor
0x30101000 RTC size 0x400 — Real-Time Clock
0x30102000 GPIOH size 0x400 — General-purpose I/Os
0x30103000 PMU size 0x400 — Power Management Unit
0x30104000 IWDG size 0x20 — Independent Watchdog Timer
0x41000000 HTIM0 size 0x400 — Advanced Timer 0
0x41001000 ADC0 size 0x400 — Analog-to-Digital Converter 0
0x41002000 ADC1 size 0x400 — Analog-to-Digital Converter 1
0x41003000 DAC0 size 0x300 — Digital-to-Analog Converter 0
0x41004000 GPIOA size 0x400 — General-purpose I/Os
0x41005000 GPIOB size 0x400 — General-purpose I/Os
0x41006000 GPIOC size 0x400 — General-purpose I/Os
0x41010000 CANFD0 size 0xF000 — CAN FD Controller 0
0x41020000 CANFD1 size 0xF000 — CAN FD Controller 1
0x41100000 SPACC size 0x40000 — Security Packet Acceleration Controller
0x41140000 PKA size 0x8000 — Public Key Accelerator
0x41150000 TRNG size 0x1000 — True Random Number Generator
0x42000000 HTIM1 size 0x400 — Advanced Timer 1
0x42002000 DAC1 size 0x300 — Digital-to-Analog Converter 1
0x42003000 GPIOD size 0x400 — General-purpose I/Os
0x42004000 GPIOE size 0x400 — General-purpose I/Os
0x42005000 GPIOF size 0x400 — General-purpose I/Os
0x42006000 GPIOG size 0x400 — General-purpose I/Os
0x42010000 CANFD2 size 0xF000 — CAN FD Controller 2
0x42020000 CANFD3 size 0xF000 — CAN FD Controller 3
0x42100000 FLASH size 0x400 — Enhanced Flash Memory Controller
0x42100800 QSPI size 0x400 — Quad Serial Peripheral Interface
0x50000000 MAC size 0x400 — Media Access Control (MAC) Controller
0x50001000 SPI0 size 0x400 — SPI Controller 0
0x50002000 SPI1 size 0x400 — SPI Controller 1
0x50003000 SPI2 size 0x400 — SPI Controller 2
0x50004000 I2C0 size 0x400 — Inter-Integrated Circuit 0
0x50005000 I2C1 size 0x400 — Inter-Integrated Circuit 1
0x50006000 USART0 size 0x400 — Universal Synchronous Asynchronous Receiver Transmitter 0
0x50007000 USART1 size 0x400 — Universal Synchronous Asynchronous Receiver Transmitter 1
0x50008000 USART2 size 0x400 — Universal Synchronous Asynchronous Receiver Transmitter 2
0x50009000 USART3 size 0x400 — Universal Synchronous Asynchronous Receiver Transmitter 3
0x5000A000 HTIM2 size 0x400 — Advanced Timer 2
0x5000B000 TIM3 size 0x400 — General Purpose Timer 3
0x5000C000 TIM4 size 0x400 — General Purpose Timer 4
0x5000D000 WWDG0 size 0x400 — Window Watchdog 0
0x51000000 SPI3 size 0x400 — SPI Controller 3
0x51001000 SPI4 size 0x400 — SPI Controller 4
0x51002000 SPI5 size 0x400 — SPI Controller 5
0x51003000 I2C2 size 0x400 — Inter-Integrated Circuit 2
0x51004000 I2C3 size 0x400 — Inter-Integrated Circuit 3
0x51005000 USART4 size 0x400 — Universal Synchronous Asynchronous Receiver Transmitter 4
0x51006000 USART5 size 0x400 — Universal Synchronous Asynchronous Receiver Transmitter 5
0x51007000 USART6 size 0x400 — Universal Synchronous Asynchronous Receiver Transmitter 6
0x51008000 USART7 size 0x400 — Universal Synchronous Asynchronous Receiver Transmitter 7
0x51009000 HTIM5 size 0x400 — Advanced Timer 5
0x5100A000 TIM6 size 0x400 — General Purpose Timer 6
0x5100B000 TIM7 size 0x400 — General Purpose Timer 7
0x5100C000 WWDG1 size 0x400 — Window Watchdog 1
0x5100D000 CRC size 0x400 — Cyclic Redundancy Check Calculation Unit
